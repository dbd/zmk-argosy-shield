## boards/shields/argosy/Kconfig.defconfig
```kconfig
if SHIELD_ARGOSY_LEFT

config ZMK_KEYBOARD_NAME
    default "Argosy"

config ZMK_SPLIT_ROLE_CENTRAL
    default y
endif

if SHIELD_ARGOSY_LEFT || SHIELD_ARGOSY_RIGHT

config ZMK_SPLIT
    default y

endif
```

## boards/shields/argosy/Kconfig.shield
```kconfig
config SHIELD_ARGOSY_LEFT
    def_bool $(shields_list_contains,argosy_left)

config SHIELD_ARGOSY_RIGHT
    def_bool $(shields_list_contains,argosy_right)
```
